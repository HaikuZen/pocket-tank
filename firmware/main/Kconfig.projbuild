## firmware/main/Kconfig.projbuild
```kconfig
menu "pocket-tank"
    config POCKET_TANK_DISPLAY_SH8601
        bool "Drive the Waveshare 1.8in AMOLED (SH8601 / CO5300 over QSPI)"
        default n
        depends on !POCKET_TANK_FNK0115 && !POCKET_TANK_CROWP4
        help
            Enable for the real board. Off = stub display port (QEMU / compile-only).
    config POCKET_TANK_ROUND
        bool "The ROUND build: a 466 px bowl for the Waveshare ESP32-S3-Touch-AMOLED-1.75C"
        default n
        help
            The tank's world is compiled in: off = the 448x368 rectangle (the
            1.8 board; on a 1.75C that image still runs, the frame shown inside
            the circle). On = TANK_ROUND, the bowl that fills the round glass;
            that image shows nothing on a 1.8. Build it with
            SDKCONFIG_DEFAULTS="sdkconfig.defaults;sdkconfig.round" into its
            own build directory and sdkconfig (docs/board-amoled-1.75c.md).
    config POCKET_TANK_WATCH
        bool "The WATCH build: a 410x502 PORTRAIT tank for the Waveshare ESP32-S3-Touch-AMOLED-2.06"
        default n
        depends on !POCKET_TANK_ROUND
        help
            On = TANK_WATCH: a tall tank the way a watch is worn, with the
            round corners of its glass; that image shows nothing on the
            other boards. Off, the 448x368 rectangle image still runs on a
            watch, on its side and centred in the glass. Build it with
            SDKCONFIG_DEFAULTS="sdkconfig.defaults;sdkconfig.watch" into its
            own build directory and sdkconfig (docs/board-amoled-2.06-watch.md).
    config POCKET_TANK_FNK0115
        bool "The FNK0115 build: an 800x480 tank for the Freenove FNK0115 (IPS: 4.3in L / 5.0in Q)"
        default n
        depends on !POCKET_TANK_ROUND && !POCKET_TANK_WATCH
        help
            On = TANK_WIDE: an 800x480 landscape tank on the board's RGB
            panel (display_port_rgb.c), GT911 touch, the director on UART0
            (the touch's I2C takes the S3's USB pins). No PMIC, IMU, RTC or
            codec on this board: the tank runs silent, upright unless turned
            in settings, its clock from the network. The TN variants (B, N:
            XPT2046 touch) are not supported. Build it with
            SDKCONFIG_DEFAULTS="sdkconfig.defaults;sdkconfig.fnk0115" into
            its own build directory and sdkconfig (docs/board-fnk0115.md).
    config POCKET_TANK_CROWP4
        bool "The CrowPanel P4 build: a 1024x600 tank for the Elecrow CrowPanel Advanced 7in / 10.1in (ESP32-P4)"
        default n
        depends on IDF_TARGET_ESP32P4 && !POCKET_TANK_ROUND && !POCKET_TANK_WATCH && !POCKET_TANK_FNK0115
        help
            On = TANK_WIDE + TANK_WIDE_1024: a 1024x600 landscape tank on the
            board's EK79007 MIPI-DSI panel (display_port_dsi.c), GT911 touch,
            the director on UART0 (the board's CH340). Wi-Fi is the onboard
            ESP32-C6 over SDIO (esp_hosted + esp_wifi_remote). No PMIC, IMU or
            RTC chip. Build it with
            SDKCONFIG_DEFAULTS="sdkconfig.defaults;sdkconfig.crowp4" into its
            own build directory and sdkconfig (docs/board-crowpanel-p4.md).
    config POCKET_TANK_PANEL_FBS
        bool
        default y if POCKET_TANK_FNK0115 || POCKET_TANK_CROWP4
        help
            The tank renders straight into the display driver's own frame
            buffers (display_port_direct_fb) instead of its own two.
    config POCKET_TANK_CONSOLE_UART0
        bool
        default y if POCKET_TANK_FNK0115 || POCKET_TANK_CROWP4
        help
            The director's console is UART0 (a USB-UART bridge on the board),
            not the chip's USB Serial/JTAG.
    config POCKET_TANK_TOUCH_FT3168
        bool "Read the FT3168 capacitive touch (taps / holds)"
        default n
    config POCKET_TANK_AUDIO_ES8311
        bool "Play the sound bank through the ES8311 codec + NS4150B amp (I2S)"
        default n
        depends on !POCKET_TANK_FNK0115 && !POCKET_TANK_CROWP4
        help
            Enable for the real board (docs/AUDIO.md). The CrowPanel P4 build
            plays through the same port without it (plain I2S, no codec). Off = stub audio port: cues compile, nothing plays.
    config POCKET_TANK_NO_PIE
        bool "Disable the PIE SIMD inference kernel (scalar dot products)"
        default n
        help
            Enable for a QEMU build if the emulator lacks ESP32-S3 PIE support.
endmenu
```
